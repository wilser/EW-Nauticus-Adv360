

/* TBD / WIP
    trying for one setup which will do these behaviors on one key assignment:
        tap: "qu"
        Shift+tap: "Qu"
        hold: "q"
            (implying Shift+_hold_ => "Q")

    NOTES learned:
        #binding-cells = # parms the behavior needs
        some can change, some must match the YAML template
        so hold-tap requires <2>, and they can be refs to further behaviors, but those need parms passed in
        e.g. &kp takes 1 key, then the &macro can take 0, (not pass any thru)
            but it does need dummy-0 passed at Keybinding layer to honor the 
            mod-morph required 2 parms
*/

// see also mod_morphs_general for c-macro example
// shortcuts_macros.dtsi for the Qu and qu macros


// mod-morph so Shift+KEY => "Qu" macro
// bindings = <1-non-shifted> <2-shifted> results ↓
    // When tap (#1) "qu" macro; when shift-tap (#2) "Qu" macro


// WORKING sort of, but couldn't get the Shift+Q working right. So abandoned and went with AHK+F# instead.
// BUT seems the syntax for mod-morph and hold-tap combining is working w.r.t. the Binding-Cells and such.

as_mm_Qu: autoshift_modmorph_Qu {
    compatible = "zmk,behavior-hold-tap";
    #binding-cells = <2>; // must have 2 per ZMK docs
    tapping-term-ms = <120>;
    quick-tap-ms = <0>;
    flavor = "tap-preferred";
    bindings = <&kp>, <&mm_SHIFT_QU>;
};

mm_SHIFT_QU: mm_SHIFT_QU {
    compatible = "zmk,behavior-mod-morph";
    #binding-cells = <0>; // so expects no (further) params
    bindings = <&m_QU>, <&m_QU_cap>;
    mods = <(MOD_LSFT)>;
};



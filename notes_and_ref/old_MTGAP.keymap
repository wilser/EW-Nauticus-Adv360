        /*****************************************************************************************************
        * L9 ▢ MTGAP / modified ["MTG"]
            URL layout: http://www.keyboard-layout-editor.com/#/gists/8b6804a7d06d148e4298ca4d7c8e3d56
            NOTES:
                • SYNTAX for mod-morph holds: "&<macro-named> <hold-key> 0"
            TODO:
                ▢ IF decide to keep, LOTS of more work to do
                ▢ #-row not done; most punc. not done
                ▢ CHORDS not added to layer-list
            */

            // DEFINES:
            #define _Y_GUI      &hm_slw LGUI Y      // GUI/Win on pinkie fingers
            #define _P_SFT      &hm_l LSHFT P       // Shift on ring fingers
            #define _O_ALT      &hm_l LALT O        // Alt on middle fingers
            #define _U_CTL      &hm_l LCTRL U       // Ctrl on index fingers
            #define _D_CTL      &hm_r RCTRL D       // Ctrl
            #define _L_ALT      &hm_r RALT L        // Alt
            #define _C_SFT      &hm_r RSFT C        // Shift
            #define _W_GUI      &hm_slw RGUI W      // GUI/Win
        // end defines
        
        mtgap_layer { bindings = <
            ___    &kp N1                  &kp N2                 &kp N3               &kp N4              &kp N5                         &to 0                              &sl L_UTL   &kp N6                        &kp N7              &kp N8              &kp N9               &kp N0                 &m_mmsNGM_Slsh BACKSLASH 0 
            ___    _Y_GUI                  _P_SFT                 _O_ALT               _U_CTL              &kp J                          ___                                ___         &kp K                         _D_CTL              _L_ALT              _C_SFT               _W_GUI                 ___
            ___    &kp I                   &kp N                  &kp E                &kp A               &m_mmsNGM_Cmma SEMI 0          ___                                ___         &kp M                         &kp H               &kp T               &kp S                &kp R                  &kp APOS
            ___    &lt L_NVE Q             &kp Z                  &lt L_UTL SLASH      &lt L_NUM PERIOD    &m_mmsNGM_Mnus UNDERSCORE 0                                                   &kp B                         &kp F               &kp G               &kp V                &kp X                  &kp COLON
            ___    &kp QUESTION            &kp QUESTION           ___                  ___                                                                                                                             ___                 ___                 ___                  ___                    ___
                                                                                                                                                ___    ___        ___    ___
                                                                                                                                                    ___            ___
                                                                                                                                    ___    ___    ___               ___    ___    ___
        >; };

        // #UNDEFs
            #undef _Y_GUI
            #undef _P_SFT
            #undef _O_ALT
            #undef _U_CTL
            #undef _D_CTL
            #undef _L_ALT
            #undef _C_SFT
            #undef _W_GUI
        // end undefs

    // END MTGAP

        /*****************************************************************************************************
        * L- : COLEMAK  -- 2023-12-20 removed from main layout - trying Engram instead - see /notes_and_ref/old_Colemak.keymap
            *      http://www.keyboard-layout-editor.com/#/gists/d5273d628b4d4cc48be28dc629304b95
            * Specials and some punctuation re-mapped via Windows Keyboard layout driver file (for Moonlander case; trying ModMorphs here...)
            *   ; → (     ` → )     F23 → :     F24 → " 
            *   And many of the Shift+___ cases.
            * SEE "mod_morphs_colemak.dtsi"
            * 
            */
            
            // top-row mods:
            #define _Q_GUI   &hm_slw LGUI Q     // GUI/Win on pinkie fingers
            #define _W_SFT   &hm_l LSHFT W      // Shift on ring fingers
            #define _F_ALT   &hm_l LALT F       // Alt on middle fingers
            #define _P_CTL   &hm_l LCTRL P      // Ctrl on index fingers
            #define _L_CTL   &hm_r RCTRL L      // Ctrl
            #define _Y_SFT   &hm_r RSHFT Y      // Alt
            #define _U_ALT   &hm_r RALT U       // Shift
            #define _SQT_GUI &hm_slw RGUI SQT   // GUI/Win
            #define _B_RALT  &hm_slw RALT B     // *Special extra Right-Alt when don't want l-alt because of AltSnap utility use
            // [ ] if/when want Punc. first and #s 2nd, simply swap the ModMorph order

            // [ ] the AS-MM has <&MM> <&kp> / invoke with &AS-MM 0 <shifted char>
                    // => did shifted char when tapped, did normal char when held, but when shift+Tap did (Shift+<shifted-char>)
            // [.] try AS-MM : <&modmorph> 
            //          [.] ↑ mostly working, the 0 not though

            colemak_layer { bindings = <
                ___      &m_mmas_CMK_1GRAVE GRAVE 0   &m_mmas_CMK_2AT AT 0   &m_mmas_CMK_3STAR STAR 0   &m_mmas_CMK_4AMPS AMPS 0   &m_mmas_CMK_5TILDE TILDE 0   &to L_NGM                      ___         &m_mmas_CMK_6CARET CARET 0   &m_mmas_CMK_7DLLR DLLR 0   &m_mmas_CMK_8HASH HASH 0     &m_mmas_CMK_9PRCNT PRCNT 0         &m_mmas_CMK_0NIL LS(F22) 0              ___                
                ___      _Q_GUI                       _W_SFT                 _F_ALT                     _P_CTL                     _B_RALT                      ___                            ___         &kp J                        _L_CTL                     _U_ALT                       _Y_SFT                             _SQT_GUI                                &as LS(F24) F24
                ___      &kp A                        &kp R                  &kp S                      &kp T                      &kp G                        ___                            ___         &kp M                        &kp N                      &kp E                        &kp I                              &kp O                                   ___
                ___      &lt L_EDT Z                  &kp X                  &kp C                      &lt L_NUM D                &lt L_UTL V                                                             &lt L_UTL K                  &kp H                      &m_mmas_CMK_CmaSemi SEMI 0   &m_mmas_CMK_DotQstn QUESTION 0     &m_mmas_CMK_SlshExc EXCLAMATION 0       &as LS(F23) F23
                ___      &as LS(LBKT) LBKT            &as LS(RBKT) RBKT      ___                        ___                                                                                                                             ___                        ___                          &m_mmas_CMK_LParLT LESS_THAN 0     &m_mmas_CMK_RParGT GREATER_THAN         ___
                                                                                                                                                                   ___    ___        ___    ___
                                                                                                                                                                        ___           ___
                                                                                                                                                        ___    ___    ___              ___    ___    ___
            >; };

            // #UNDEFs
                #undef _Q_GUI  
                #undef _W_SFT  
                #undef _F_ALT  
                #undef _P_CTL  
                #undef _L_CTL  
                #undef _Y_SFT  
                #undef _U_ALT  
                #undef _SQT_GUI
                #undef _B_RALT 

        // END Colemak

/*****************************************************************************************************
 *      TAP DANCE configurations
 *
 *****************************************************************************************************/
#include <dt-bindings/zmk/keys.h>

tdEmjWin: tap_dance_emoji_winchange {
    compatible = "zmk,behavior-tap-dance";
    label = "tap_dance_emoji_winchange";
    #binding-cells = <0>;
    tapping-term-ms = <300>;
    bindings = <&kp RG(SEMI)>, <&kp RG(TAB)>;  /*  ← this actually worked! */
};

tdCapsWrdLck: tap_dance_capsword_capslock {
    compatible = "zmk,behavior-tap-dance";
    label = "tap_dance_capsword_capslock";
    #binding-cells = <0>;
    tapping-term-ms = <300>;
    bindings = <&caps_word>, <&kp CAPSLOCK>;
};

tdLR_E: tap_dance_lightroom_e_key {
    // (1x) Shift+E (toggle preview window)
    // (2x) Ctrl+E (edit in Photoshop)
    compatible = "zmk,behavior-tap-dance";
    label = "tap_dance_lightroom_e_key";
    #binding-cells = <0>;
    tapping-term-ms = <300>;
    bindings = <&kp LS(E)>, <&kp LC(E)>;
};




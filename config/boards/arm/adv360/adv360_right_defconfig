## config/boards/arm/adv360/adv360_right_defconfig
```kconfig
#
# Copyright (c) 2022 The ZMK Contributors
# SPDX-License-Identifier: MIT
#

CONFIG_SOC_SERIES_NRF52X=y
CONFIG_SOC_NRF52840_QIAA=y
CONFIG_BOARD_ADV360_RIGHT=y

# Enable MPU
CONFIG_ARM_MPU=y

# enable GPIO
CONFIG_GPIO=y

# Enable SPI for LEDS
CONFIG_PINCTRL=y
CONFIG_SPI=y
CONFIG_SPI_NRFX=y

# Enable writing to flash
CONFIG_USE_DT_CODE_PARTITION=y
CONFIG_MPU_ALLOW_FLASH_WRITE=y
CONFIG_NVS=y
CONFIG_SETTINGS_NVS=y
CONFIG_FLASH=y
CONFIG_FLASH_PAGE_LAYOUT=y
CONFIG_FLASH_MAP=y

# Enable 32kHz crystal
CONFIG_CLOCK_CONTROL_NRF_K32SRC_XTAL=y
CONFIG_CLOCK_CONTROL_NRF_K32SRC_150PPM=y

#RGB leds config
CONFIG_WS2812_STRIP=y
CONFIG_ZMK_RGB_UNDERGLOW=y
CONFIG_ZMK_RGB_UNDERGLOW_EXT_POWER=y
CONFIG_ZMK_RGB_UNDERGLOW_ON_START=y
CONFIG_ZMK_RGB_UNDERGLOW_EFF_START=4
CONFIG_ZMK_RGB_UNDERGLOW_AUTO_OFF_IDLE=y

#Backlighting configuration
CONFIG_PWM=y
CONFIG_LED_PWM=y
CONFIG_ZMK_BACKLIGHT=y
CONFIG_ZMK_BACKLIGHT_BRT_START=20
CONFIG_ZMK_BACKLIGHT_AUTO_OFF_IDLE=y

#Misc configuration
CONFIG_USB_DEVICE_VID=0x29EA
CONFIG_USB_DEVICE_PID=0x0362
CONFIG_USB_DEVICE_MANUFACTURER="Kinesis Corporation"
CONFIG_BT_CTLR_TX_PWR_PLUS_8=y

#see https://zmk.dev/docs/config/system
#see https://github.com/zmkfirmware/zmk/issues/1460
#see https://github.com/zmkfirmware/zmk/issues/1236

#seems NKRO (default) a mostly compatible, but allows some extended codes. But not reliably working with F13-F24...
#might need also the Extended Report option?
#CONFIG_ZMK_HID_REPORT_TYPE_NKRO=y 
#CONFIG_ZMK_HID_KEYBOARD_EXTENDED_REPORT=y
#and-or maybe this option related to F13-F24 - to FULL instead of BASIC (default)
#CONFIG_ZMK_HID_CONSUMER_REPORT_USAGES_BASIC=y
#CONFIG_ZMK_HID_CONSUMER_REPORT_USAGES_FULL=y
#conclusion 2024-04-13: just commenting OUT the NKRO line worked

CONFIG_BUILD_OUTPUT_UF2=y

CONFIG_ZMK_BLE_EXPERIMENTAL_FEATURES=y

CONFIG_ZMK_BLE=y
CONFIG_ZMK_USB=y

# EW test 'idle' setting for hacking the small LED status lights timeout - see notes in LEFT file
# trying 5 minutes RH but 20 min LH / with diff. settings, seemed timed out sooner / try 20 min on both sides
CONFIG_ZMK_IDLE_TIMEOUT=1200000
```

/*****************************************************************************************************
* L4 🔴 UTL - Utils, Macros, Specials
*  # keys send to that layer-#
*  &m_SLEEP & &m_HIBER = Windows-menu-compatible key shortcuts to invoke Sleep, Hibernate from start-menu
*  &m_CSA_R = Ctrl+Shift+Alt+(R) => SlickRun - but macro to hold/release deliberately because timing issues with RDP
*
* [ ] TODO - need to investigate with Kinesis functions; low prio.
*       [ ] is BT4 'off'? - seems like it (light goes off)
*       [.] DISC explicitly disconnects one? 2024-09-19 trying
*/

// #DEFs
    #define _BTLD &bootloader
    #define _RgbMem &rgb_ug RGB_MEFS_CMD
    #define _RGB_TG &rgb_ug RGB_TOG
    #define _BKL_TG &bl BL_TOG
    #define _MONOFF &kp RC(RG(L)) // Win+Ctrl+L invokes my AHK lock+monoff macro
// end #DEFs

util_layer { bindings = <
    &m_KVM_PgUp  &to 1          &to 2          &to 3          &to 4          &to 5          &to L_0                                              _MONOFF   &to 6    &to 7    &to 8     &to 9      &to 10   &m_CSA_R
    &m_KVM_PgDn  &bt BT_SEL 0   &bt BT_SEL 1   &bt BT_SEL 2   &bt BT_SEL 3   &bt BT_SEL 4   _x_                                                  &m_SLEEP  _x_      &kp N1   &kp N2    &kp N3     &kp N4   &kp RS(N2)
    ___          _x_            _x_            _x_            _x_            _x_            _x_       _x_   &kp C_VOL_UP  _BKL_TG  _RGB_TG       &m_HIBER  _x_      &m_M1    &m_M2     &m_M3      &m_M4    &kp RS(N3)
    &bt BT_CLR   &bt BT_DISC 0  &bt BT_DISC 1  &bt BT_DISC 2  &bt BT_DISC 3  &bt BT_DISC 4                 &kp C_VOL_DN    &bt BT_CLR                      _x_      &m_M5    &m_M6     &m_M7      &m_M8    &kp RS(N4)
    _BTLD        _x_            _x_            ___            ___                              ___    ___   &kp C_MUTE      &bt BT_CLR_ALL  ___  ___                &m_M9    &m_M10    &kp N7     &kp N8   _BTLD
>; };

// #UNDEFs
    #undef _BTLD
    #undef _RgbMem
    #undef _RGB_TG
    #undef _BKL_TG
    #undef _MONOFF
// end #UNDEFs

/*****************************************************************************************************
* L8 ⚫🟡 QRT layer - Qwerty-ish / such as for games
    */

    qwerty_layer { bindings = <
        &kp GRAVE  &kp N1   &kp N2   &kp N3   &kp N4   &kp N5   &to L_0                                       ___    &kp N6   &kp N7   &kp N8     &kp N9      &kp N0    &kp EQUAL
        ___        &kp Q    &kp W    &kp E    &kp R    &kp T    ___                                           ___    &kp Y    &kp U    &kp I      &kp O       &kp P     &kp SLASH
        ___        &kp A    &kp S    &kp D    &kp F    &kp G    ___      &kp LSHFT  &kp LCTRL   ___  ___      ___    &kp H    &kp J    &kp K      &kp L       &kp SEMI  ___
        ___        &kp Z    &kp X    &kp C    &kp V    &kp B                         &kp LALT   ___                  &kp N    &kp M    &kp COMMA  &kp PERIOD  ___       ___
        ___        ___      ___      ___      ___             &kp BSPC  &kp DEL  &kp LC(LALT)   ___  ___  ___                 ___      ___        ___         ___       &kp BSLH
    >; };


/*****************************************************************************************************
* L3 🟢 NUM - Num-pad
*      Uses non-keypad NUMERAL symbols since plan to use as "main" numbers method eventually as practice more.
*      See companion 'mod_morphs_nums' file
*      Some same as NGM / but redefined to use KP symbol: - * / - ... see AHK for couple special-case overrides like Excel
*/

// DEFINES (in layout order: across rows, then down):

    // Row 1 — right half
    #define _APOS_EURO     &mms_num_apos LC(LA(F16)) 0  // AHK: €
    #define _BKSL_PIPE     &mms_ngm_bksl PIPE 0
    #define _LPAR_LT       &mms_num_lpar LT 0
    #define _DOT_CMMA      &mms_num_dot COMMA 0
    #define _RPAR_GT       &mms_num_rpar GT 0
    #define _EQAL_TILD     &mms_num_eqal TILDE 0

    // Row 2 — right half
    #define _DLLR_DQT      &mms_num_dllr DQT 0
    #define _N7_MINUTE     &ht_minute 0 N7
    #define _N8_AMUC       &ht_am_uc 0 N8
    #define _N9_PMUC       &ht_pm_uc 0 N9
    #define _MULT_TIMES    &mms_num_mult LC(LA(F23)) 0  // AHK: ×
    #define _DIV_PCT       &mms_num_divd PRCNT 0

    // Row 3 — inner thumb + right half
    #define _CTLENT_ENT    &as KP_ENTER LC(ENTER)  // tap=Ctrl+Enter, hold=(kp)Enter
    #define _BSP_NAV       &lt L_NAV BSPC        // tap=BSPC, hold=NAV layer
    #define _COLN_SEMI     &mms_num_coln SEMI 0
    #define _N4_4TH        &ht_4th 0 N4
    #define _N5_AMLC       &ht_am_lc 0 N5
    #define _N6_PMLC       &ht_pm_lc 0 N6
    #define _MNUS_UNDR     &mms_num_mnus LS(MINUS) 0

    // Row 4 — right half
    #define _N1_1ST        &ht_1st 0 N1
    #define _N2_2ND        &ht_2nd 0 N2
    #define _N3_3RD        &ht_3rd 0 N3
    #define _PLUS_AMP      &mms_num_plus LS(N7) 0
    #define _Q_H           &mms_num_q_h LS(H) 0

    // Row 5 — inner thumb + right half
    #define _ENT_FNC       &lt L_FNC ENTER      // tap=Enter, hold=Fn layer (same as NGM)
    #define _UP_LEFT       &as LEFT UP
    #define _DN_RIGHT      &as RIGHT DOWN
// end defines

numpad_layer { bindings = <
    ___      ___        ___  ___  ___  ___        &to L_NGM                                                   _APOS_EURO  _BKSL_PIPE  _LPAR_LT    _DOT_CMMA   _RPAR_GT  _EQAL_TILD   &m_CSA_R
    ___      ___        ___  ___  ___  ___        ___                                                         &kp PG_UP   _DLLR_DQT   _N7_MINUTE  _N8_AMUC    _N9_PMUC  _MULT_TIMES  _DIV_PCT
    ___      &kp LC(D)  ___  ___  ___  &kp LC(D)  ___         &kp LSHFT  &to L_0  _CTLENT_ENT  _BSP_NAV       &kp PG_DN   _COLN_SEMI  _N4_4TH     _N5_AMLC    _N6_PMLC  &kp N0       _MNUS_UNDR
    &to L_0  &mo L_EDT  ___  ___  _x_  ___                                 ___     &kp RS(TAB)                            ___         _N1_1ST     _N2_2ND     _N3_3RD   _PLUS_AMP    _Q_H
    ___      ___        ___  ___  ___                           ___  ___  ___       &kp TAB  ___  &kp SPACE                           _UP_LEFT    _DN_RIGHT   ___       ___          &to L_0
>;};

// #UNDEFS:
    // Row 1
    #undef _APOS_EURO
    #undef _BKSL_PIPE
    #undef _LPAR_LT
    #undef _DOT_CMMA
    #undef _RPAR_GT
    #undef _EQAL_TILD
    // Row 2
    #undef _DLLR_DQT
    #undef _N7_MINUTE
    #undef _N8_AMUC
    #undef _N9_PMUC
    #undef _MULT_TIMES
    #undef _DIV_PCT
    // Row 3
    #undef _CTLENT_ENT
    #undef _BSP_NAV
    #undef _COLN_SEMI
    #undef _N4_4TH
    #undef _N5_AMLC
    #undef _N6_PMLC
    #undef _MNUS_UNDR
    // Row 4
    #undef _N1_1ST
    #undef _N2_2ND
    #undef _N3_3RD
    #undef _PLUS_AMP
    #undef _Q_H
    // Row 5
    #undef _ENT_FNC
    #undef _UP_LEFT
    #undef _DN_RIGHT
    //#undef _AS_APOS_EU
// end undefs

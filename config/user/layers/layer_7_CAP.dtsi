/*****************************************************************************************************
* L7 🟡 CAPS layer - like SHIFT but keep symbols & few other differences
*   TODO
*   - _tbd_: {-ING, -TION, Qu, }
*/

// #DEFs
    #define _AHK_AT &kp RC(RA(AT_SIGN))
    #define _CAP_Q &ht_QU_Q LS(Q) 0
    #define _CAP_ING  &ht_ucase_ing N5 0                  // tap=ING macro, hold=5
    #define _CAP_TION &ht_ucase_tion N6 0                 // tap=TION macro, hold=6
// end #DEFs

ngmcap_layer { bindings = <
    ___   ___        ___        ___        ___        _CAP_ING  &to L_0                                  ___    _CAP_TION   ___        ___        ___        ___        &kp LS(Z)
    ___   &kp RS(B)  &kp RS(Y)  &kp RS(O)  &kp RS(U)  ___       ___                                      ___    ___         &kp LS(L)  &kp LS(D)  &kp LS(W)  &kp LS(V)  ___
    ___   &kp RS(C)  &kp RS(I)  &kp RS(E)  &kp RS(A)  ___       ___       ___  ___     ___  &kp BSPC     ___    ___         &kp LS(H)  &kp LS(T)  &kp LS(S)  &kp LS(N)  ___
    ___   &kp RS(G)  &kp RS(X)  &kp RS(J)  &kp RS(K)  _AHK_AT                  ___     ___                      ___         &kp LS(R)  &kp LS(M)  &kp LS(F)  &kp LS(P)  _CAP_Q
    ___   ___        ___        ___        ___                       ___  ___  ___     ___  ___  ___                        ___        ___        ___        ___        ___
>; };

// #UNDEFs
    #undef _AHK_AT
    #undef _CAP_Q
    #undef _CAP_ING
    #undef _CAP_TION
// END UNDEFs


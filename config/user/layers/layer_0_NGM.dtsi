/*****************************************************************************************************
* L0 ⚫ NGM - Engram
    • ALT LAYOUTS must be LOWER in stack than any higher ones want to layer-hold shift to
    • SYNTAX for mod-morph holds: "&<mms_name> <hold-key> 0"
    • [] revisit whether to make R- L- hold-mods for different effects on other side keys?
    • AHK mappings (updated 2024-09-20)
        F20 Ø
        F21 •
        ^!F17 --
        !F21 →
*/

// DEFINES (in layout order: across rows, then down):

    // Row 1 — top row
    #define _TILD_PIPE      &mms_ngm_tild PIPE 0
    #define _EXCL_N1        &mms_ngm_excl N1 0
    #define _QSTN_N2        &mms_ngm_qstn N2 0
    #define _CMMA_N3        &mms_ngm_cmma N3 0
    #define _APOS_N4        &mms_ngm_apos N4 0
    #define _ING_N5         &mms_ngm_ing N5 0             // AHK: F14 >> ing
    #define _TION_N6        &mms_ngm_tion N6 0            // AHK: F15 >> tion
    #define _LPAR_N7        &mms_ngm_lpar N7 0
    #define _PERD_N8        &mms_ngm_perd N8 0
    #define _RPAR_N9        &mms_ngm_rpar N9 0
    #define _EQUL_N0        &mms_ngm_equl N0 0

    // Row 2 — alpha + hold mods
    #define _B_GUI          &hm_slw LGUI B
    #define _Y_SFT          &hm_l LSHFT Y
    #define _O_ALT          &hm_med_l LALT O
    #define _U_CTL          &hm_med_l LCTRL U
    #define _STAR_F16       &mms_ngm_star F16 0           // AHK: F16 >> "Ø"
    #define _HYPER          &kp LC(LA(LS(LGUI)))
    #define _TD_SCRSHOTS    &td_win_ss_snagit             // 1x: Win+Shift+S   2x: Ctrl+Shift+Alt+P
    #define _QUOT_DLLR      &mms_ngm_quot DLLR 0
    #define _L_CTL          &hm_med_r RCTRL L             // 2026-03-11 : weird RH hold behaviors IF THROUGH KVM since RH *Ctrl* is a KVM control. Need to change it or force BT only.
    #define _D_ALT          &hm_med_r RALT D
    #define _W_SFT          &hm_r RSFT W
    #define _V_GUI          &hm_slw RGUI V
    #define _SLSH_PRCNT     &mms_ngm_slsh PRCNT 0

    // Row 3 — home row
    #define _TAB_SHTAB      &mt LS(TAB) TAB
    #define _I_RSI          &as_slw RS(I) I
    #define _SEMI_LT        &mms_ngm_semi LT 0
    #define _MEH            &kp LC(LA(LSHFT))
    #define _CPWRD_CAPS     &ht_cap_cw L_CAP 0            // hold=CAPS layer; tap=capWORD
    #define _NUM_LR         &ht_num_tolr_tonum L_NUM 0
    #define _BSLH_LET       &lt L_LET BSLH                // hold=letter layer; tap=backslash
    #define _BSLH_BSP_R     &mm_BACKSLASH_BACKSPACE_R     // see mod_morphs_general.dtsi
    #define _DT1_DT0        &mms_ngm_d1d0 RC(RA(F17)) 0   // AHK Ctrl+Alt+{F17,F18}: Date1/Date0
    #define _COLN_GT        &mms_ngm_coln GT 0
    #define _MNUS_UNDER     &mms_ngm_mnus UNDER 0

    // Row 4 — lower row
    #define _GRAV_CARET     &mms_ngm_grav CARET 0
    #define _AMPS_AT        &mms_ngm_amps AT 0
    #define _HM_CTLHM       &as_slw RC(HOME) HOME
    #define _HASH_PLUS      &mms_ngm_hash PLUS 0
    #define _QU_Q           &ht_qu_QU Q 0                 // auto-shift means Shift gets the Hold (Q) behavior

    // Row 5 — thumb row
    #define _TD_EMOJ_DSKT   &td_emj_wdsk                  // 1x: open emoji desktop; 2x: open emoji desktop + move mouse (hold to drag)
    #define _BUL_ARW        &as F17 F15
    #define _TD_RTCLK_P     &td_rtclick_p                 // 1x: right-click; 2x: right-click + move mouse (hold to drag)
    #define _BSP_CTLBSP     &as_thr_fst RC(BSPC) BSPC       // tap=BSPC, hold=Ctrl+BSPC, tap→tap+hold=BSPC repeat
    #define _END_CTLEND     &as_slw RC(END) END
    #define _LBKT_LBRC      &as LS(LBKT) LBKT
    #define _RBKT_RBRC      &as LS(RBKT) RBKT

// end defines

engram_layer { bindings = <
    _TILD_PIPE     _EXCL_N1     _QSTN_N2     _CMMA_N3     _APOS_N4         _ING_N5    &sl L_UTL                                                                      &sl L_UTL     _TION_N6    _LPAR_N7  _PERD_N8  _RPAR_N9    _EQUL_N0    &kp Z
    &kp ESC        _B_GUI       _Y_SFT       _O_ALT       _U_CTL           _STAR_F16  _HYPER                                                                         _TD_SCRSHOTS  _QUOT_DLLR  _L_CTL    _D_ALT    _W_SFT      _V_GUI      _SLSH_PRCNT
    _TAB_SHTAB     &kp C        _I_RSI       &kp E        &kp A            _SEMI_LT   _MEH              _CPWRD_CAPS  _NUM_LR  _BSLH_LET  _BSLH_BSP_R                 _DT1_DT0      _COLN_GT    &kp H     &kp T     &kp S       &kp N       _MNUS_UNDER
    _GRAV_CARET    &lt L_EDT G  &kp X        &lt L_UTL J  &lt_fst L_NUM K  _AMPS_AT                               _HM_CTLHM    &kp PG_UP                                           _HASH_PLUS  &kp R     &kp M     &kp F       &kp P       _QU_Q
    _TD_EMOJ_DSKT  _BUL_ARW     _TD_RTCLK_P  &kp LEFT     &kp RIGHT                _BSP_CTLBSP  &lt L_EDT DEL  _END_CTLEND      &kp PG_DN  &lt L_FNC ENTER  &kp SPACE                          &kp UP    &kp DOWN  _LBKT_LBRC  _RBKT_RBRC  &to L_NUM
>; };

// #UNDEFs (same order as defines)
    // Row 1
    #undef _TILD_PIPE
    #undef _EXCL_N1
    #undef _QSTN_N2
    #undef _CMMA_N3
    #undef _APOS_N4
    #undef _ING_N5
    #undef _TION_N6
    #undef _LPAR_N7
    #undef _PERD_N8
    #undef _RPAR_N9
    #undef _EQUL_N0
    // Row 2
    #undef _B_GUI
    #undef _Y_SFT
    #undef _O_ALT
    #undef _U_CTL
    #undef _STAR_F16
    #undef _HYPER
    #undef _TD_SCRSHOTS
    #undef _QUOT_DLLR
    #undef _L_CTL
    #undef _D_ALT
    #undef _W_SFT
    #undef _V_GUI
    #undef _SLSH_PRCNT
    // Row 3
    #undef _TAB_SHTAB
    #undef _I_RSI
    #undef _SEMI_LT
    #undef _MEH
    #undef _CPWRD_CAPS
    #undef _NUM_LR
    #undef _BSLH_LET
    #undef _BSLH_BSP_R
    #undef _DT1_DT0
    #undef _COLN_GT
    #undef _MNUS_UNDER
    // Row 4
    #undef _GRAV_CARET
    #undef _AMPS_AT
    #undef _HM_CTLHM
    #undef _HASH_PLUS
    #undef _QU_Q
    // Row 5
    #undef _TD_EMOJ_DSKT
    #undef _BUL_ARW
    #undef _TD_RTCLK_P
    #undef _BSP_CTLBSP
    #undef _END_CTLEND
    #undef _LBKT_LBRC
    #undef _RBKT_RBRC
// end undefs


/* *********************************************************************************************
 * Experiments / other notes:
    • trying a 3-way (or 2-way) hold-tap-mod that would do {,} tap {3} hold/shift, and {...} with multi-tap or similar
      wasn't able yet to get timing right // 2026-03-07
        //#define TD_Cmma_3_Dot3  &TD_Cmma_3_Ellipses // 2026-03-07 tried tap-dance comma→3-ellipses; timing not right
        //#undef TD_Cmma_3_Dot3

 */

#include <dt-bindings/zmk/keys.h>

// Standalone mod-morphs — uses MOD_MORPH(NAME, B1, B2, MODS) from def_macros.dtsi

// 2025-12-29 currently using
// When LEFT SHIFT held, RIGHT SHIFT acts as backspace
// (hold left-thumb shift, but backspace is on a different left-thumb key)
MOD_MORPH(mm_BACKSLASH_BACKSPACE_R, BSLH, BACKSPACE, MOD_LSFT)


// 2025-12-29 Ø using these:
// MOD_MORPH(mm_SHIFT_BACKSPACE_R,   RSHFT, BACKSPACE, MOD_LSFT)
// MOD_MORPH(mm_SHIFT_BACKSPACE_L,   LSHFT, BACKSPACE, MOD_RSFT)


/* TAP ONCE (don't repeat when held)
 * TBD experiment - macro to "press once" a key / based on CPP template
 * adapted from: https://github.com/manna-harbour/miryoku_zmk/blob/master/miryoku/miryoku_kludge_tapdelay.h
 * see also: https://www.reddit.com/r/olkb/comments/ys9y1h/how_to_prevent_zmk_repeating_a_key_when_held/
 */

// unsure need:
// #pragma once

// CPP macro from example:
/*
#define m_TAPONCE(CODE) \
/ { \
  macros { \
    ZMK_MACRO(m_taponce_##CODE, bindings = <&macro_press &kp CODE>, <&macro_release &kp CODE>;) \
  }; \
};
*/


//==================================================

            // [.] WIP - not working yet / 2023-06-18

//==================================================

// [Note 2024-04-16: label removed in ZMK v3, so might be easier.]

// EW try own CPP macro format:
/*
#define m_1TAP(KEY) \
    m_1TAP_##KEY: m_1TAP_##KEY { \
        compatible = "zmk,behavior-macro"; \
        wait-ms = <20>; \
        tap-ms = <30>; \
        #binding-cells = <0>; \
        bindings = <&macro_press &kp KEY>, <&macro_release &kp KEY>; \
    }; 
*/

// build CPP-macro created list:
/*
{
    // 2023-06-18: temp test: need #6-9, and F9 for Lightroom layer
    macros {
        ZMK_MACRO(m_taponce_N6, bindings = <&macro_press &kp N6>, <&macro_release &kp N6>);
        ZMK_MACRO(m_taponce_N7, bindings = <&macro_press &kp N7>, <&macro_release &kp N7>);
        ZMK_MACRO(m_taponce_N8, bindings = <&macro_press &kp N8>, <&macro_release &kp N8>);
        ZMK_MACRO(m_taponce_N9, bindings = <&macro_press &kp N9>, <&macro_release &kp N9>);
        ZMK_MACRO(m_taponce_F9, bindings = <&macro_press &kp F9>, <&macro_release &kp F9>);
    };
};
*/

// try one brute force to see if works before the sub ones
m_1TAP_EW_N6: m_1TAP_EW_N6{
    compatible = "zmk,behavior-macro";
    wait-ms = <40>;
    tap-ms = <20>;
    #binding-cells = <0>;
    bindings = <&macro_tap &kp N6>;
};

// generate many via macros:
// m_1TAP(N7)
// m_1TAP(N8)

// [ ] maybe a direct "hold tap" case but which sends the "macro tap" instead of just &kp?
// see as1t in adv360.keymap also



// **************************************************
// Macros just because certain other behaviors expect a single parameter but want something more complex
// to use with, e.g., l_m (layer-macro) hold-tap behavior
// **************************************************

// [ ] todo: hold → Layer1/temp, tap → Layer2/toggle
// see: https://www.reddit.com/r/ErgoMechKeyboards/comments/123sapj/zmk_question_can_i_layertap_with_a_macro/

// Ideas: make Macro to hard-code the "&to LYR" part, then combine with the &l_m, such as &l_m HOLD_LAYER 0 (where 0 because macro no parm)
// OR: make the Macro parameterized to take a LYR number, then could have like hold-tap-layer: <hold-layer> <tap-to-layer>
// OR: maybe not needed because can define a hold-tap behavior with <&mo><&to> bindings and just pass layer numbers for both?!



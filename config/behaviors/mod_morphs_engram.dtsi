/* TODO & NOTES - see mod_morphs_colemak file */
/* CODES ref: https://zmk.dev/docs/codes */

/*
    2023-12-21: trying shorter macro-sub names vs. prior Colemak cases
*/

/* ASSUMES GENERAL ONE INCLUDED BEFORE THIS ONE! */
/* first label "mm<>" goes to "m_mm<>" for the &mm<> ref in layouts */

// ---------- NEW WIP LAYOUTS 2024-02-19+ ---------- //
// F14 >> AHK(~ing)
// F15 >> AHK(~tion)
// F20 >> AHK(Ø)
// F21 >> AHK(•)
// F24 >> — / m-dash [Alt+F24 Ø working; Ø-idea why]
// Alt+F21 >> → / rt-arrow
// Note: (` grave; # hash, - minus, ...)

// TOP ROW (L to R)
  MOD_MORPH_SHIFT(mmNG2_Tild  , TILDE      , PIPE     , mmsNG2_Tild)
  MOD_MORPH_SHIFT(mmNG2_Star  , STAR       , N1       , mmsNG2_Star)
  MOD_MORPH_SHIFT(mmNG2_Qstn  , QMARK      , N2       , mmsNG2_Qstn)
//MOD_MORPH_SHIFT(mmNG2_Apos  , APOS       , N2       , mmsNG2_Apos)
  MOD_MORPH_SHIFT(mmNG2_Cmma  , COMMA      , N3       , mmsNG2_Cmma)
  MOD_MORPH_SHIFT(mmNG2_Apos  , APOS       , N4       , mmsNG2_Apos)
//MOD_MORPH_SHIFT(mmNG2_Qstn  , QMARK      , N4       , mmsNG2_Qstn)
  MOD_MORPH_SHIFT(mmNG2_Ing   , F14        , N5       , mmsNG2_Ing ) // F14 "ing"
  
  MOD_MORPH_SHIFT(mmNG2_Tion  , F15        , N6       , mmsNG2_Tion) // F15 tion
  MOD_MORPH_SHIFT(mmNG2_Excl  , EXCL       , N7       , mmsNG2_Excl)
  MOD_MORPH_SHIFT(mmNG2_Perd  , PERIOD     , N8       , mmsNG2_Perd)
  MOD_MORPH_SHIFT(mmNG2_Quot  , DQT        , N9       , mmsNG2_Quot)  
  MOD_MORPH_SHIFT(mmNG2_Equl  , EQUAL      , N0       , mmsNG2_Equl)

// Left Bottom
  MOD_MORPH_SHIFT(mmNG2_Bksl  , BSLH       , PIPE     , mmsNG2_Bksl)
  MOD_MORPH_SHIFT(mmNG2_Cret  , CARET      , GRAVE    , mmsNG2_Cret)

 // L-MID COLUMN (T to B): 
  MOD_MORPH_SHIFT(mmNG2_Lpar  , LPAR       , F20      , mmsNG2_Lpar) // F20 Ø
  MOD_MORPH_SHIFT(mmNG2_Semi  , SEMI       , LT       , mmsNG2_Semi)
  MOD_MORPH_SHIFT(mmNG2_Amps  , AMPS       , AT       , mmsNG2_Amps)

// R-MID COLUMN (T to B): 
  MOD_MORPH_SHIFT(mmNG2_Rpar  , RPAR       , DLLR     , mmsNG2_Rpar)
  MOD_MORPH_SHIFT(mmNG2_Coln  , COLON      , GT       , mmsNG2_Coln)
  MOD_MORPH_SHIFT(mmNG2_Hash  , HASH       , PLUS     , mmsNG2_Hash)
 
// Rh COLUMN (T to B): 
  MOD_MORPH_SHIFT(mmNG2_Slsh  , SLASH      , PRCNT    , mmsNG2_Slsh)
  MOD_MORPH_SHIFT(mmNG2_Mnus  , MINUS      , UNDER    , mmsNG2_Mnus)
  

  // Special for Q:
    // tap|hold {qu,QU}; hold/shift {q,Q}
    // uses "&as_Qu Q 0" in map; 0 parm for the nil macro parm
    as_Qu: auto_shift_Qu {
      compatible = "zmk,behavior-hold-tap";
      #binding-cells = <2>;
      tapping-term-ms = <150>;
      quick-tap-ms = <0>;
      flavor = "tap-preferred";
      bindings = <&kp>, <&mm_QU>; // can do to mod-morph?
  };
  
  // temp 2024-12-08:
   MOD_MORPH_SHIFT(mmNG2_Mdsh  , F24        ,  BACKSLASH   , mmsNG2_Mdsh) //not working?!

/* [.] try brute force all the way dwn?
mm_MdshBslh: mm_QU {
    compatible = "zmk,behavior-mod-morph";
    #binding-cells = <0>;
    bindings = <&m_qu>, <&m_qu_cap>;
    mods = <(MOD_LSFT|MOD_RSFT)>;
  };
*/


/*********************
   * PRIOR ones - in case want back easily...

  //MOD_MORPH_SHIFT(mmNG2_Excl  , EXCL       , N5       , mmsNG2_Excl)
  //MOD_MORPH_SHIFT(mmNG2_Tion  , F15        , N6       , mmsNG2_Tion) // F15 tion
  //MOD_MORPH_SHIFT(mmNG2_LsTh  , LT         , N6       , mmsNG2_LsTh)
  //MOD_MORPH_SHIFT(mmNG2_Semi  , SEMI       , N6       , mmsNG2_Semi)
  //MOD_MORPH_SHIFT(mmNG2_GrTh  , GT         , N7       , mmsNG2_GrTh)
  //MOD_MORPH_SHIFT(mmNG2_Quot  , DQT        , N7       , mmsNG2_Quot)  
  //MOD_MORPH_SHIFT(mmNG2_Lpar  , LPAR       , N7       , mmsNG2_Lpar)
  //MOD_MORPH_SHIFT(mmNG2_Quot  , DQT        , N9       , mmsNG2_Quot)  
  //MOD_MORPH_SHIFT(mmNG2_GrTh  , GT         , N9       , mmsNG2_GrTh)
  //MOD_MORPH_SHIFT(mmNG2_Rpar  , RPAR       , N9       , mmsNG2_Rpar)
  //MOD_MORPH_SHIFT(mmNG2_Ing   , F14        , F21      , mmsNG2_Ing ) // F14 "ing", F21 •
  //MOD_MORPH_SHIFT(mmNG2_Ing   , F14        , F20      , mmsNG2_Ing ) // F14 "ing", F20 Ø
  //MOD_MORPH_SHIFT(mmNG2_Quot  , DQT        , TILDE    , mmsNG2_Quot)  
  //MOD_MORPH_SHIFT(mmNG2_Cmma  , COMMA      , SEMI     , mmsNG2_Cmma)
  //MOD_MORPH_SHIFT(mmNG2_Semi  , SEMI       , TILDE    , mmsNG2_Semi)
  //MOD_MORPH_SHIFT(mmNG2_Amps  , AMPS       , LT       , mmsNG2_Amps) 
  //MOD_MORPH_SHIFT(mmNG2_Tion  , F15        , DLLR     , mmsNG2_Tion) // F15 tion
  //MOD_MORPH_SHIFT(mmNG2_Perd  , PERIOD     , PLUS     , mmsNG2_Perd)
  //MOD_MORPH_SHIFT(mmNG2_Coln  , COLON      , PLUS     , mmsNG2_Coln)
  //MOD_MORPH_SHIFT(mmNG2_Hash  , HASH       , AT       , mmsNG2_Hash)
  //MOD_MORPH_SHIFT(mmNG2_Tion  , F15        , GRAVE    , mmsNG2_Tion) // F15 tion

   */
  

#include <dt-bindings/zmk/keys.h>

/* pattern

m_##MM_NAME: m_##MM_NAME { \
    compatible = "zmk,behavior-mod-morph"; \
    #binding-cells = <0>; \
    bindings = <&kp KEY>, <&kp MOD_KEY>; \
    mods = <(MOD_LSFT|MOD_RSFT)>; \
}; \

[] 2024-04-16 think label property deprecated for most(all?) behaviors

*/

// When LEFT SHIFT being held, make the RIGHT SHIFT act as backspace for convenience
// (because in my layout, I usually hold left-thumb shift, but backspace normally is on a different left-thumb key)
mm_SHIFT_BACKSPACE_R: mm_SHIFT_BACKSPACE_R {
    compatible = "zmk,behavior-mod-morph";
    #binding-cells = <0>;
    bindings = <&kp RSHFT>, <&kp BACKSPACE>;
    mods = <(MOD_LSFT)>;
};

mm_SHIFT_BACKSPACE_L: mm_SHIFT_BACKSPACE_L {
    compatible = "zmk,behavior-mod-morph";
    #binding-cells = <0>;
    bindings = <&kp LSHFT>, <&kp BACKSPACE>;
    mods = <(MOD_RSFT)>;
};


// GENERAL HELPER FOR ALT LAYOUTS - NEEDED FOR NON-STANDARD KEY | SHIFT-KEY COMBOS ...
// [ ] TODO: still need to make it so the last-param (name) isn't needed; funky C-style syntax, not sure... (2024-04-14)
#define MOD_MORPH_SHIFT(MM_NAME, KEY, MOD_KEY, AS_NAME) m_##MM_NAME: m_##MM_NAME { \
    compatible = "zmk,behavior-mod-morph"; \
    #binding-cells = <0>; \
    bindings = <&kp KEY>, <&kp MOD_KEY>; \
    mods = <(MOD_LSFT|MOD_RSFT)>; \
}; \
m_##AS_NAME: m_##AS_NAME { \
    compatible = "zmk,behavior-hold-tap"; \
    #binding-cells = <2>; \
    tapping-term-ms = <150>; \
    quick-tap-ms = <0>; \
    flavor = "tap-preferred"; \
    bindings = <&kp>, <&m_##MM_NAME>; \
}; \



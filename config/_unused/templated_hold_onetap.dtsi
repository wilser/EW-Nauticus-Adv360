// needed if included elsewhere?
#include <dt-bindings/zmk/keys.h>
/*
        AS1T_2: AS_1TAP_2 {
            compatible = "zmk,behavior-hold-tap";
            #binding-cells = <2>;
            tapping-term-ms = <150>;
            quick-tap-ms = <0>;
            flavor = "tap-preferred";
            bindings = <&m_1TAP_EW_N6>, <&kp>; // try with 1st position a direct "tap key" macro? !!! THIS WORKS (but would require special AS and Macro for each)
        };
        
         AS1T_3: AS1T_3 {
            compatible = "zmk,behavior-hold-tap";
            #binding-cells = <2>;
            tapping-term-ms = <150>;
            quick-tap-ms = <0>;
            flavor = "tap-preferred";
            bindings = &macro_tap <&kp>, <&kp>; // can we force the "macro tap" in a pattern?
        };
*/
        AS1T_4: AS1T_4 {
            compatible = "zmk,behavior-hold-tap";
            #binding-cells = <2>;
            tapping-term-ms = <150>;
            quick-tap-ms = <0>;
            flavor = "tap-preferred";
            bindings = <&macro_tap N8>, <&kp>; // try hard-coded 1st binding (& pass dummy 0)
        };



#define gen_AS_1TAP_HOLD(HOLDKEY, NORMKEY) \
    AS1TAP_##HOLDKEY_##NORMKEY: AS1TAP_##HOLDKEY_##NORMKEY { \
        compatible = "zmk,behavior-macro"; \
        wait-ms = <20>; \
        tap-ms = <30>; \
        #binding-cells = <0>; \
        bindings = <&macro_press &kp KEY>, <&macro_release &kp KEY>; \
    }; 


// Urh, not read....
/*
    THINKING something like:   
    
    make a Macro that just taps K1
    then gen a Hold-Tap that binds to MAC-K1(hold) and K2 (normal tap)
    then assign ^ special hold tap - 1 each - to the layer - might need 'nil' passed parm





*/